## boards/shields/Kconfig.defconfig
```kconfig
if SHIELD_MACROBOSS5500

config ZMK_KEYBOARD_NAME
    default "MacroBoss5500"

endif
```

## boards/shields/macroboss5500/Kconfig.shield
```kconfig
config SHIELD_MACROBOSS5500
    def_bool $(shields_list_contains, macroboss5500)
```
